## boards/shields/lily60/Kconfig.shield
```kconfig
# Copyright (c) 2025
# SPDX-License-Identifier: MIT

config SHIELD_LILY60_LEFT
    def_bool $(shields_list_contains,lily60_left)

config SHIELD_LILY60_RIGHT
    def_bool $(shields_list_contains,lily60_right)
```
