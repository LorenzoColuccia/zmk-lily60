/*
 * Copyright (c) 2025
 * SPDX-License-Identifier: MIT
 */

#include "lily60.dtsi"

/*
 * Pin label on nice!nano -> actual nRF52840 GPIO
 *
 * ROWS:
 * r0 = board pin 9  -> P1.06 -> &gpio1 6
 * r1 = board pin 5  -> P0.24 -> &gpio0 24
 * r2 = board pin 6  -> P1.00 -> &gpio1 0
 * r3 = board pin 7  -> P0.11 -> &gpio0 11
 * r4 = board pin 8  -> P1.04 -> &gpio1 4
 *
 * COLS:
 * c1 = board pin 10 -> P0.09 -> &gpio0 9
 * c2 = board pin 16 -> P0.10 -> &gpio0 10
 * c3 = board pin 14 -> P0.23 -> &gpio0 23
 * c4 = board pin 15 -> P0.21 -> &gpio0 21
 * c5 = board pin 18 -> P0.28 -> &gpio0 28
 * c6 = board pin 19 -> P0.02 -> &gpio0 2
 * c7 = board pin 20 -> P0.29 -> &gpio0 29
 *
 * I2C for OLED:
 * SDA = board pin 2 -> P0.17
 * SCL = board pin 3 -> P0.20
 */

&kscan0 {
    row-gpios
        = <&gpio1 6  (GPIO_ACTIVE_HIGH | GPIO_PULL_DOWN)>  // r0 - board pin 9
        , <&gpio0 24 (GPIO_ACTIVE_HIGH | GPIO_PULL_DOWN)>  // r1 - board pin 5
        , <&gpio1 0  (GPIO_ACTIVE_HIGH | GPIO_PULL_DOWN)>  // r2 - board pin 6
        , <&gpio0 11 (GPIO_ACTIVE_HIGH | GPIO_PULL_DOWN)>  // r3 - board pin 7
        , <&gpio1 4  (GPIO_ACTIVE_HIGH | GPIO_PULL_DOWN)>  // r4 - board pin 8
        ;

    col-gpios
        = <&gpio0 9  GPIO_ACTIVE_HIGH>  // c1 - board pin 10
        , <&gpio0 10 GPIO_ACTIVE_HIGH>  // c2 - board pin 16
        , <&gpio0 23 GPIO_ACTIVE_HIGH>  // c3 - board pin 14
        , <&gpio0 21 GPIO_ACTIVE_HIGH>  // c4 - board pin 15
        , <&gpio0 28 GPIO_ACTIVE_HIGH>  // c5 - board pin 18
        , <&gpio0 2  GPIO_ACTIVE_HIGH>  // c6 - board pin 19
        , <&gpio0 29 GPIO_ACTIVE_HIGH>  // c7 - board pin 20
        ;
};

&pro_micro_i2c {
    status = "okay";

    oled: ssd1306@3c {
        compatible = "solomon,ssd1306fb";
        reg = <0x3c>;
        width = <128>;
        height = <32>;
        segment-offset = <0>;
        page-offset = <0>;
        display-offset = <0>;
        multiplex-ratio = <31>;
        segment-remap;
        com-invdir;
        com-sequential;
        prechargep = <0x22>;
    };
};
