/*
 * Copyright (c) 2025
 * SPDX-License-Identifier: MIT
 */

#include "lily60.dtsi"

&default_transform {
    col-offset = <7>;
};

/*
 * Pin label on nice!nano -> actual nRF52840 GPIO
 * Same pin mapping as left half (symmetric wiring)
 */

&kscan0 {
    row-gpios
        = <&gpio1 6  (GPIO_ACTIVE_HIGH | GPIO_PULL_DOWN)>  // r0 - board pin 9
        , <&gpio0 24 (GPIO_ACTIVE_HIGH | GPIO_PULL_DOWN)>  // r1 - board pin 5
        , <&gpio1 0  (GPIO_ACTIVE_HIGH | GPIO_PULL_DOWN)>  // r2 - board pin 6
        , <&gpio0 11 (GPIO_ACTIVE_HIGH | GPIO_PULL_DOWN)>  // r3 - board pin 7
        , <&gpio1 4  (GPIO_ACTIVE_HIGH | GPIO_PULL_DOWN)>  // r4 - board pin 8
        ;

    col-gpios
        = <&gpio0 9  GPIO_ACTIVE_HIGH>  // c1 - board pin 10
        , <&gpio0 10 GPIO_ACTIVE_HIGH>  // c2 - board pin 16
        , <&gpio0 23 GPIO_ACTIVE_HIGH>  // c3 - board pin 14
        , <&gpio0 21 GPIO_ACTIVE_HIGH>  // c4 - board pin 15
        , <&gpio0 28 GPIO_ACTIVE_HIGH>  // c5 - board pin 18
        , <&gpio0 2  GPIO_ACTIVE_HIGH>  // c6 - board pin 19
        , <&gpio0 29 GPIO_ACTIVE_HIGH>  // c7 - board pin 20
        ;
};

&pro_micro_i2c {
    status = "okay";

    oled: ssd1306@3c {
        compatible = "solomon,ssd1306fb";
        reg = <0x3c>;
        width = <128>;
        height = <32>;
        segment-offset = <0>;
        page-offset = <0>;
        display-offset = <0>;
        multiplex-ratio = <31>;
        segment-remap;
        com-invdir;
        com-sequential;
        prechargep = <0x22>;
    };
};
