/*
 * Copyright (c) 2025
 * SPDX-License-Identifier: MIT
 */

#include <dt-bindings/zmk/matrix_transform.h>

/ {
    chosen {
        zmk,kscan = &kscan0;
    };

    kscan0: kscan {
        compatible = "zmk,kscan-gpio-matrix";
        label = "KSCAN";
        
        diode-direction = "col2row";
        
        row-gpios
            = <&gpio0 9  (GPIO_ACTIVE_HIGH | GPIO_PULL_DOWN)>  // R0
            , <&gpio0 5  (GPIO_ACTIVE_HIGH | GPIO_PULL_DOWN)>  // R1
            , <&gpio0 6  (GPIO_ACTIVE_HIGH | GPIO_PULL_DOWN)>  // R2
            , <&gpio0 7  (GPIO_ACTIVE_HIGH | GPIO_PULL_DOWN)>  // R3
            , <&gpio0 8  (GPIO_ACTIVE_HIGH | GPIO_PULL_DOWN)>  // R4
            ;
        
        col-gpios
            = <&gpio0 10 GPIO_ACTIVE_HIGH>  // C1
            , <&gpio0 16 GPIO_ACTIVE_HIGH>  // C2
            , <&gpio0 14 GPIO_ACTIVE_HIGH>  // C3
            , <&gpio0 15 GPIO_ACTIVE_HIGH>  // C4
            , <&gpio0 18 GPIO_ACTIVE_HIGH>  // C5
            , <&gpio0 19 GPIO_ACTIVE_HIGH>  // C6
            , <&gpio0 20 GPIO_ACTIVE_HIGH>  // C7
            ;
    };
};